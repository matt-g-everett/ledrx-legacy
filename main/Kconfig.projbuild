## main/Kconfig.projbuild
```kconfig
# put here your custom config value
menu "ledrx Configuration"
config WIFI_SSID
    string "WiFi SSID"
    default "ssid"
    help
	    SSID (network name) for the example to connect to.

config WIFI_PASSWORD
    string "WiFi Password"
    default "password"
    help
	    WiFi password (WPA or WPA2) for the example to use.

config FIRMWARE_UPG_URL
    string "OTA Firmware URL (HTTPS)"
    default "https://192.168.1.148:8070/ledrx.bin"
    help
        HTTPS URL containing the latest firmware.

config FIRMWARE_VERSION_URL
    string "OTA Firmware Version URL (HTTPS)"
    default "https://192.168.1.148:8070/version"
    help
        HTTPS URL with the version of the latest firmware in semver format.

endmenu
```
